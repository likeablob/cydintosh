## sdkconfig.defaults
```kconfig
# ESP32-CYD (Cheap Yellow Display) Configuration
CONFIG_IDF_TARGET="esp32"

# Disable PSRAM (CYD doesn't have it)
# CONFIG_SPIRAM is not set

# Flash size 4MB
CONFIG_ESPTOOLPY_FLASHSIZE_4MB=y
CONFIG_ESPTOOLPY_FLASHSIZE="4MB"

# Performance optimization
CONFIG_COMPILER_OPTIMIZATION_PERF=y
CONFIG_ESP_DEFAULT_CPU_FREQ_MHZ_240=y
CONFIG_ESP_DEFAULT_CPU_FREQ_MHZ=240

# Watchdog settings
CONFIG_ESP_TASK_WDT_TIMEOUT_S=10
CONFIG_ESP_TASK_WDT_CHECK_IDLE_TASK_CPU0=n
CONFIG_ESP_TASK_WDT_CHECK_IDLE_TASK_CPU1=n

# Disable Bluetooth (not used in CYD build)
# CONFIG_BT_ENABLED is not set

# Console output
CONFIG_ESP_CONSOLE_UART=y

# WiFi (STA mode)
CONFIG_ESP_WIFI_ENABLED=y
CONFIG_ESP_WIFI_STA_CONNECTED_SCAN=y

# Reduce WiFi buffers to save RAM for Mac emulation
CONFIG_ESP_WIFI_DYNAMIC_RX_BUFFER_NUM=4
CONFIG_ESP_WIFI_DYNAMIC_TX_BUFFER_NUM=4
CONFIG_ESP_WIFI_STATIC_RX_BUFFER_NUM=2
CONFIG_ESP_WIFI_STATIC_RX_BUFFER_SIZE=1600
CONFIG_ESP_WIFI_RX_BA_WIN=2
CONFIG_ESP_WIFI_MGMT_BUFFER_NUM=4

# MQTT Configuration
CONFIG_MQTT_PROTOCOL_5=n
CONFIG_MQTT_TRANSPORT_SSL=n
CONFIG_MQTT_TRANSPORT_WEBSOCKET=n
CONFIG_MQTT_TRANSPORT_WEBSOCKET_SECURE=n

# Touch screen config
# Touch sensitivity (lower = more sensitive, default=400)
CONFIG_XPT2046_Z_THRESHOLD=300
```
